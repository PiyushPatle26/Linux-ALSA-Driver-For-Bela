## Documentation/devicetree/bindings/sound/bela,audio-cape.yaml
```yaml
# SPDX-License-Identifier: GPL-2.0-only OR BSD-2-Clause
%YAML 1.2
---
$id: http://devicetree.org/schemas/sound/bela,audio-cape.yaml#
$schema: http://devicetree.org/meta-schemas/core.yaml#

title: Bela Audio Cape Machine Driver (Bela Gem Multi)

# NOTE: This binding is for the custom machine driver (bela.c) which is
# NOT yet ported to AM62x. The Stereo board uses simple-audio-card and
# does not need this binding. The Multi board can also use
# simple-audio-card with multi-DAI-link as an alternative.
# This binding will be finalised when bela.c is ported to AM62x.

maintainers:
  - Piyush Patle <piyushpatle1228@gmail.com>
  - Giulio Moro <giuliomoro@gmail.com>

description: |
  The Bela Gem Multi is a multi-channel audio cape for PocketBeagle2
  (AM62x). It combines codecs on a shared TDM bus driven by McASP2:

    TLV320AIC3106 — stereo codec, 2 inputs + 2 outputs, BCLK/WCLK master
    ES9080Q       — 8-channel DAC, outputs only, BCLK/WCLK slave

  Total I/O: 10 outputs (2 AIC3106 + 8 ES9080Q) + 2 inputs (AIC3106).

  Clock topology:
    McASP2 outputs MCLK (12.288 MHz from 96 MHz PLL / 8) to TLV320AIC3106.
    TLV320AIC3106 PLL generates BCLK (256 clocks/frame) and WCLK (48 kHz)
    fed back to McASP2 and ES9080Q. Both McASP and ES9080Q are clock slaves.

  TDM slot allocation (16 slots x 32 bits):
    Slots  0-1  : TLV320AIC3106 (stereo in/out)
    Slots  2-9  : ES9080Q (8-channel output)
    Slots 10-15 : Unused

allOf:
  - $ref: sound-card.yaml#

properties:
  compatible:
    const: bela,audio-cape

  model:
    description: User-visible sound card name.

  cpu-dai:
    $ref: /schemas/types.yaml#/definitions/phandle
    description:
      Phandle to the McASP2 node. Operates as BCLK and WCLK consumer.

  aic3104-codec:
    $ref: /schemas/types.yaml#/definitions/phandle
    description: |
      Phandle to the TLV320AIC3106 codec node. This codec acts as
      BCLK and WCLK master for the shared TDM bus.
      Named aic3104-codec for driver compatibility (tlv320aic3x family).

  es9080q-codec:
    $ref: /schemas/types.yaml#/definitions/phandle
    description:
      Phandle to the ES9080Q DAC node. Operates as TDM slave.

  audio-routing:
    $ref: /schemas/types.yaml#/definitions/non-unique-string-array
    description:
      DAPM route pairs connecting board connectors to codec widget names.

  clocks:
    maxItems: 1
    description:
      Master clock (MCLK) reference. On AM62x this is audio_refclk1
      (12.288 MHz = 96 MHz / 8).

  clock-names:
    items:
      - const: mclk

required:
  - compatible
  - cpu-dai
  - aic3104-codec
  - es9080q-codec
  - clocks
  - clock-names

additionalProperties: false

examples:
  - |
    i2c {
        #address-cells = <1>;
        #size-cells = <0>;

        tlv320aic3106: codec@18 {
            compatible = "ti,tlv320aic3106";
            reg = <0x18>;
            #sound-dai-cells = <0>;
        };

        es9080q: dac@48 {
            compatible = "ess,es9080q";
            reg = <0x48>;
            #sound-dai-cells = <0>;
            ess,write-only-addr = <0x4c>;
        };
    };

    sound {
        compatible = "bela,audio-cape";
        model = "PocketBeagle2 Bela Gem Multi";

        cpu-dai = <&mcasp2>;
        aic3104-codec = <&tlv320aic3106>;
        es9080q-codec = <&es9080q>;

        clocks = <&audio_refclk1>;
        clock-names = "mclk";

        audio-routing =
            "Headphone Jack",   "HPLOUT",
            "Headphone Jack",   "HPROUT",
            "AIC3104 Line Out", "LLOUT",
            "AIC3104 Line Out", "RLOUT",
            "LINE1L",           "Line In",
            "LINE1R",           "Line In",
            "DAC Out 1",        "OUT1",
            "DAC Out 2",        "OUT2",
            "DAC Out 3",        "OUT3",
            "DAC Out 4",        "OUT4",
            "DAC Out 5",        "OUT5",
            "DAC Out 6",        "OUT6",
            "DAC Out 7",        "OUT7",
            "DAC Out 8",        "OUT8";
    };
```

## Documentation/devicetree/bindings/sound/bela-audio.yaml
```yaml
# SPDX-License-Identifier: GPL-2.0-only OR BSD-2-Clause
%YAML 1.2
---
$id: http://devicetree.org/schemas/sound/bela,audio-cape.yaml#
$schema: http://devicetree.org/meta-schemas/core.yaml#

title: Bela Audio Cape Machine Driver

maintainers:
  - Jian De <jiande2020@gmail.com>
  - Giulio Moro <giuliomoro@gmail.com>
  - Piyush Patle <piyushpatle1228@gmail.com>

description: |
  The Bela Audio Cape is a multi-channel audio interface for BeagleBone
  single-board computers. It combines two audio codecs on a shared TDM bus:

    TLV320AIC3104 — stereo codec, 2 inputs + 2 outputs, BCLK/FSYNC master
    ES9080Q       — 8-channel DAC, outputs only, BCLK/FSYNC slave

  Total I/O: 10 outputs (2 from AIC3104 + 8 from ES9080Q) + 2 inputs.
  A single ALSA sound card is created covering both codecs.

  Clock topology:
    MCLK:       24.576 MHz (48 kHz family) or 22.5792 MHz (44.1 kHz family),
                supplied to both codecs via the clocks property.
    BCLK/FSYNC: Generated by TLV320AIC3104 at 256 clocks per frame and shared
                with ES9080Q and McASP, both of which operate as clock consumers.

  TDM slot allocation (16 slots × 32 bits):
    Slots  0-1  : TLV320AIC3104 (stereo in/out)
    Slots  2-9  : ES9080Q (8-channel output)
    Slots 10-15 : Unused

allOf:
  - $ref: sound-card.yaml#

properties:
  compatible:
    const: bela,audio-cape

  cpu-dai:
    $ref: /schemas/types.yaml#/definitions/phandle
    description:
      Phandle to the McASP node that provides the TDM serial bus.
      The McASP operates as a BCLK and FSYNC consumer (slave).

  aic3104-codec:
    $ref: /schemas/types.yaml#/definitions/phandle
    description:
      Phandle to the TLV320AIC3104 codec node. This codec acts as
      BCLK and FSYNC master for the shared TDM bus.

  es9080q-codec:
    $ref: /schemas/types.yaml#/definitions/phandle
    description:
      Phandle to the ES9080Q DAC node. Operates as TDM slave,
      receiving BCLK and FSYNC from the TLV320AIC3104.

  clocks:
    maxItems: 1
    items:
      - description:
          Master clock (MCLK) supplied to both codecs. Use 24.576 MHz for
          the 48 kHz sample-rate family and 22.5792 MHz for the 44.1 kHz
          family. The machine driver switches the rate automatically when
          the application selects a different sample rate.

  clock-names:
    maxItems: 1
    items:
      - const: mclk

required:
  - compatible
  - cpu-dai
  - aic3104-codec
  - es9080q-codec
  - clocks
  - clock-names

additionalProperties: false

examples:
  - |
    #include <dt-bindings/gpio/gpio.h>

    /* Codec nodes — normally appear under their respective I2C bus node */
    i2c {
        #address-cells = <1>;
        #size-cells = <0>;

        tlv320aic3104: codec@18 {
            compatible = "ti,tlv320aic3104";
            reg = <0x18>;
            #sound-dai-cells = <0>;
            clocks = <&clk_mcasp0>;
            clock-names = "mclk";
        };

        es9080q: dac@48 {
            compatible = "ess,es9080q";
            reg = <0x48>;
            #sound-dai-cells = <0>;
            ess,write-only-addr = <0x4c>;
            reset-gpios = <&gpio0 11 GPIO_ACTIVE_LOW>;
        };
    };

    sound {
        compatible = "bela,audio-cape";
        model = "Bela Audio Cape RevC";

        cpu-dai = <&mcasp0>;
        aic3104-codec = <&tlv320aic3104>;
        es9080q-codec = <&es9080q>;

        clocks = <&clk_mcasp0>;
        clock-names = "mclk";

        audio-routing =
            "Headphone Jack",   "HPLOUT",
            "Headphone Jack",   "HPROUT",
            "AIC3104 Line Out", "LLOUT",
            "AIC3104 Line Out", "RLOUT",
            "LINE1L",           "Line In",
            "LINE1R",           "Line In",
            "DAC Out 1",        "OUT1",
            "DAC Out 2",        "OUT2",
            "DAC Out 3",        "OUT3",
            "DAC Out 4",        "OUT4",
            "DAC Out 5",        "OUT5",
            "DAC Out 6",        "OUT6",
            "DAC Out 7",        "OUT7",
            "DAC Out 8",        "OUT8";
    };
```

## Documentation/devicetree/bindings/sound/ess,es9080q.yaml
```yaml
# SPDX-License-Identifier: GPL-2.0-only OR BSD-2-Clause
%YAML 1.2
---
$id: http://devicetree.org/schemas/sound/ess,es9080q.yaml#
$schema: http://devicetree.org/meta-schemas/core.yaml#

title: ESS Technology ES9080Q 8-Channel Audio DAC

maintainers:
  - Piyush Patle <piyushpatle1228@gmail.com>
  - Giulio Moro <giuliomoro@gmail.com>

description: |
  The ES9080Q is an 8-channel 32-bit audio DAC with TDM input.
  Register control is via I2C. The chip has two I2C address ranges:

    - Primary (e.g. 0x48): read/write registers 0–164 and
      read-only registers 224–255. Used for audio configuration,
      volume control, TDM setup, and status readback.

    - Secondary (e.g. 0x4C): write-only registers 192–203.
      Used for soft reset, PLL configuration, and GPIO control.
      The secondary address is always primary + 4.

  On the Bela Gem Multi cape the ES9080Q operates as a TDM slave,
  receiving BCLK and WCLK from a TLV320AIC3106 codec. Audio data
  arrives via McASP TDM serializers.

allOf:
  - $ref: /schemas/sound/audio-dai.yaml#

properties:
  compatible:
    const: ess,es9080q

  reg:
    maxItems: 1
    description:
      I2C address of the primary read/write interface (e.g. 0x48).

  ess,write-only-addr:
    $ref: /schemas/types.yaml#/definitions/uint32
    description: |
      I2C address of the write-only register interface (e.g. 0x4C).
      The driver creates a dummy I2C client at this address on the
      same adapter for PLL and reset register access. If omitted,
      PLL configuration is unavailable and the driver logs a warning.

  reset-gpios:
    maxItems: 1
    description: |
      Optional GPIO connected to the CHIP_EN / hardware reset pin.
      Active-high: assert low to reset, deassert high to enable.
      Omit on boards where reset is tied to a board-level GPIO hog
      or power-on-reset domain.

  "#sound-dai-cells":
    const: 0

  clocks:
    maxItems: 1
    description: Master clock (MCLK) input, if supplied externally.

  clock-names:
    items:
      - const: mclk

required:
  - compatible
  - reg
  - "#sound-dai-cells"

additionalProperties: false

examples:
  - |
    #include <dt-bindings/gpio/gpio.h>
    i2c {
        #address-cells = <1>;
        #size-cells = <0>;

        es9080q: dac@48 {
            compatible = "ess,es9080q";
            reg = <0x48>;
            #sound-dai-cells = <0>;
            ess,write-only-addr = <0x4c>;
        };
    };
```
